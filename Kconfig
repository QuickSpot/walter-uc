## Kconfig
```kconfig
menu "unified-comms"
    menu "default selects"
        config ESP_MODEM_URC_HANDLER_DEFAULT
            bool "DON't TOUCH"
            default y
            select ESP_MODEM_URC_HANDLER
            help
                This option enables the ESP_MODEM URC handler by default.
    
        config ESP_LWIP_PPP_HANDLER_DEFAULT
            bool "DON't TOUCH"
            default y
            select LWIP_PPP_SUPPORT
            help
                This option enables the LWIP ppp handler by default.
    endmenu
endmenu
```

## examples/bluecherry/sdkconfig.defaults
```kconfig
CONFIG_ESP_TLS_USING_MBEDTLS=y
CONFIG_MBEDTLS_SSL_DTLS_CONNECTION_ID=y
CONFIG_MBEDTLS_SSL_PROTO_DTLS=y
CONFIG_ESP_MAIN_TASK_STACK_SIZE=8192
```
